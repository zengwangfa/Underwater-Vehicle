#include "include.h"
#define XLevelL		0x00
#define XLevelH		0x10
#define XLevel		((XLevelH&0x0F)*16+XLevelL)
#define Max_Column	128
#define Max_Row		  64
#define	Brightness	0xCF 



#define X_WIDTH 128
#define Y_WIDTH 64
//======================================
const byte F6x8[][6] =
{
    { 0x00, 0x00, 0x00, 0x00, 0x00, 0x00 },   // sp
    { 0x00, 0x00, 0x00, 0x2f, 0x00, 0x00 },   // !
    { 0x00, 0x00, 0x07, 0x00, 0x07, 0x00 },   // "
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    { 0x14, 0x14, 0x14, 0x14, 0x14, 0x14 }    // horiz lines
};
const byte F14x16_Idx[] = 
{
  "按键电压电机舵机参数修改模式一二三四五左右开启状态转择线心占差速度电机中心线阀值"
};
const byte F14x16[] = {  //取模方式 列行式


0x10,0x10,0xFF,0x90,0x50,0x98,0x88,0x88,0xE9,0x8E,0x88,0x88,0x98,0x88,
0x42,0x81,0x7F,0x00,0x40,0x40,0x26,0x25,0x18,0x08,0x16,0x31,0x60,0x20,//按20
0x30,0xEF,0x28,0x28,0x44,0x64,0xDC,0x10,0x54,0xFF,0x54,0x54,0x7C,0x10,
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0x00,0x00,0x7F,0x00,0x40,0x7F,0x4A,0x4A,0x4A,0x4A,0x4A,0x7F,0x40,0x00,/*"值",1*/







};






//======================================================
// 128X64I液晶底层驱动[8X16]字体库
// 设计者: powerint
// 描  述: [8X16]西文字符的字模数据 (纵向取模,字节倒序)
// !"#$%&'()*+,-./0123456789:;<=>?@ABCDEFGHIJKLMNOPQRSTUVWXYZ[\]^_`abcdefghijklmnopqrstuvwxyz{|}~
//======================================================
const byte F8X16[]=
{
  0x00,0x00,0x00,0x00,0x00,0x00,0x00,0x00,0x00,0x00,0x00,0x00,0x00,0x00,0x00,0x00,// 0
  0x00,0x00,0x00,0xF8,0x00,0x00,0x00,0x00,0x00,0x00,0x00,0x33,0x30,0x00,0x00,0x00,//!1
  0x00,0x10,0x0C,0x06,0x10,0x0C,0x06,0x00,0x00,0x00,0x00,0x00,0x00,0x00,0x00,0x00,//"2
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  0x00,0x06,0x01,0x01,0x02,0x02,0x04,0x04,0x00,0x00,0x00,0x00,0x00,0x00,0x00,0x00,//~94

};
//数据水平，字节垂直768


void Dly_ms(uint16 ms)
{
  vuint16 ii,jj;
  if (ms<1) ms=1;
  ms = ms*12 ;
  for(ii=0;ii<ms;ii++)
    for(jj=0;jj<1335;jj++);  //16MHz--1ms
  //   for(jj=0;jj<4006;jj++);  //48MHz--1ms
  //for(jj=0;jj<5341;jj++);    //64MHz--1ms
}

void LCD_WrDat(byte data)
{
	byte i=8;
        LCD_DC_HIGH;;;;    //LCD_DC=1;;
        asm("nop"); 
        LCD_SCL_LOW;;;;    //LCD_SCL=0;;
        asm("nop");    
  while(i--)
  {
       if(data&0x80)
       {
        LCD_SDA_HIGH;;;;  //LCD_SDA=1
       }
       else
       {
        LCD_SDA_LOW;;;;  //LCD_SDA=0
       }
       LCD_SCL_HIGH;     //LCD_SCL=1;;
       asm("nop");;;;
       LCD_SCL_LOW;;;;;   //LCD_SCL=0;;   
       data<<=1;    
  }	
}
void LCD_WrCmd(byte cmd)
{
     byte i=8;
     LCD_DC_LOW;;;;; //LCD_DC=0;;
     LCD_SCL_LOW;;;;;//LCD_SCL=0;; 
    
  while(i--)
  {
	
    if(cmd&0x80)
    {
      LCD_SDA_HIGH;;;;;//LCD_SDA=1
    }
    else
    {
      LCD_SDA_LOW;;;;;;//LCD_SDA=0
    }
      LCD_SCL_HIGH;;;;;//LCD_SCL=1;; 
    asm("nop");;;;
		           
      LCD_SCL_LOW;;;;; //LCD_SCL=0;;    
      cmd<<=1;;;;;   
  } 	
	//LCD_CS=1;
}
void LCD_Set_Pos(byte x, byte y)
{ 
  LCD_WrCmd(0xb0+y);
  LCD_WrCmd(((x&0xf0)>>4)|0x10);
  LCD_WrCmd((x&0x0f)|0x00); 
} 
void LCD_Fill(byte bmp_data)
{
	byte y,x;
	
	for(y=0;y<8;y++)
	{
		LCD_WrCmd(0xb0+y);
		LCD_WrCmd(0x01);
		LCD_WrCmd(0x10);
		for(x=0;x<X_WIDTH;x++)
			LCD_WrDat(bmp_data);
	}
}
void LCD_CLS(void)
{
	byte y,x;	
	for(y=0;y<8;y++)
	{
		LCD_WrCmd(0xb0+y);
		LCD_WrCmd(0x01);
		LCD_WrCmd(0x10); 
		for(x=0;x<X_WIDTH;x++)
			LCD_WrDat(0);
	}
}
void LCD_DLY_ms(word ms)
{                         
  word a;
  while(ms)
  {
    a=13350;
    while(a--);
    ms--;
  }
  return;
}

void LCD_Init(void)        
{        
  
  //设置GPIOC 为GPIO口 	
  LCD_Port_Init();
  //设置GPIOC 为输出方向		 
  LCD_SCL_HIGH;//LCD_SCL
  LCD_RST_LOW;//LCD_RST 
  LCD_DLY_ms(50);
  LCD_RST_HIGH;//LCD_RST 

  LCD_WrCmd(0xae);//--turn off oled panel
  LCD_WrCmd(0x00);//---set low column address
  LCD_WrCmd(0x10);//---set high column address
  LCD_WrCmd(0x40);//--set start line address  Set Mapping RAM Display Start Line (0x00~0x3F)
  LCD_WrCmd(0x81);//--set contrast control register
  LCD_WrCmd(0xcf); // Set SEG Output Current Brightness
  LCD_WrCmd(0xa0);//--Set SEG/Column Mapping     0xa0左右反置 0xa1正常
  LCD_WrCmd(0xc0);//Set COM/Row Scan Direction   0xc0上下反置 0xc8正常
  LCD_WrCmd(0xa6);//--set normal display
  LCD_WrCmd(0xa8);//--set multiplex ratio(1 to 64)
  LCD_WrCmd(0x3f);//--1/64 duty
  LCD_WrCmd(0xd3);//-set display offset	Shift Mapping RAM Counter (0x00~0x3F)
  LCD_WrCmd(0x00);//-not offset
  LCD_WrCmd(0xd5);//--set display clock divide ratio/oscillator frequency
  LCD_WrCmd(0x80);//--set divide ratio, Set Clock as 100 Frames/Sec
  LCD_WrCmd(0xd9);//--set pre-charge period
  LCD_WrCmd(0xf1);//Set Pre-Charge as 15 Clocks & Discharge as 1 Clock
  LCD_WrCmd(0xda);//--set com pins hardware configuration
  LCD_WrCmd(0x12);
  LCD_WrCmd(0xdb);//--set vcomh
  LCD_WrCmd(0x40);//Set VCOM Deselect Level
  LCD_WrCmd(0x20);//-Set Page Addressing Mode (0x00/0x01/0x02)
  LCD_WrCmd(0x02);//
  LCD_WrCmd(0x8d);//--set Charge Pump enable/disable
  LCD_WrCmd(0x14);//--set(0x10) disable
  LCD_WrCmd(0xa4);// Disable Entire Display On (0xa4/0xa5)
  LCD_WrCmd(0xa7);// Disable Inverse Display On (0xa6/a7) 
  LCD_WrCmd(0xaf);//--turn on oled panel
  LCD_Fill(0x00);  //初始清屏
  LCD_Set_Pos(0,0);  
	
} 
//==============================================================
//函数名： void LCD_PutPixel(byte x,byte y)
//功能描述：绘制一个点（x,y）
//参数：真实坐标值(x,y),x的范围0～127，y的范围0～64
//返回：无
//==============================================================
void LCD_PutPixel(byte x,byte y)
{
	byte data1;  //data1当前点的数据 
	 
        LCD_Set_Pos(x,y); 
	data1 = 0x01<<(y%8); 	
	LCD_WrCmd(0xb0+(y>>3));
	LCD_WrCmd(((x&0xf0)>>4)|0x10);
	LCD_WrCmd((x&0x0f)|0x00);
	LCD_WrDat(data1); 	 	
}
//==============================================================
//函数名： void LCD_Rectangle(byte x1,byte y1,
//                   byte x2,byte y2,byte color,byte gif)
//功能描述：绘制一个实心矩形
//参数：左上角坐标（x1,y1）,右下角坐标（x2，y2）
//      其中x1、x2的范围0～127，y1，y2的范围0～63，即真实坐标值
//返回：无
//==============================================================
void LCD_Rectangle(byte x1,byte y1,byte x2,byte y2,byte gif)
{
	byte n; 
		
	LCD_Set_Pos(x1,y1>>3);
	for(n=x1;n<=x2;n++)
	{
		LCD_WrDat(0x01<<(y1%8)); 			
		if(gif == 1) 	LCD_DLY_ms(50);
	}  
	LCD_Set_Pos(x1,y2>>3);
  for(n=x1;n<=x2;n++)
	{
		LCD_WrDat(0x01<<(y2%8)); 			
		if(gif == 1) 	LCD_DLY_ms(5);
	}
	
}  
//==============================================================
//函数名：LCD_P6x8Str(byte x,byte y,byte *p)
//功能描述：写入一组标准ASCII字符串
//参数：显示的位置（x,y），y为页范围0～7，要显示的字符串
//返回：无
//==============================================================  
void LCD_P6x8Str(byte x,byte y,byte ch[])
{
  byte c=0,i=0,j=0;      
  while (ch[j]!='\0')
  {    
    c =ch[j]-32;
    if(x>126){x=0;y++;}
    LCD_Set_Pos(x,y);    
  	for(i=0;i<6;i++)     
  	  LCD_WrDat(F6x8[c][i]);  
  	x+=6;
  	j++;
  }
}


//==============================================================
//函数名：LCD_P8x16Str(byte x,byte y,byte *p)
//功能描述：写入一组标准ASCII字符串
//参数：显示的位置（x,y），y为页范围0～7，要显示的字符串
//返回：无
//==============================================================  
void LCD_P8x16Str(byte x,byte y,byte ch[])
{
  byte c=0,i=0,j=0;
        
  while (ch[j]!='\0')
  {    
    c =ch[j]-32;
    if(x>120){x=0;y++;}
    LCD_Set_Pos(x,y);    
  	for(i=0;i<8;i++)     
  	  LCD_WrDat(F8X16[c*16+i]);
  	LCD_Set_Pos(x,y+1);    
  	for(i=0;i<8;i++)     
  	  LCD_WrDat(F8X16[c*16+i+8]);  
  	x+=8;
  	j++;
  }
}
//输出汉字字符串
void LCD_P14x16Str(byte x,byte y,byte ch[])
{
	byte wm=0,ii = 0;
	word adder=1; 
	
	while(ch[ii] != '\0')
	{
  	wm = 0;
  	adder = 1;
  	while(F14x16_Idx[wm] > 127)
  	{
  		if(F14x16_Idx[wm] == ch[ii])
  		{
  			if(F14x16_Idx[wm + 1] == ch[ii + 1])
  			{
  				adder = wm * 14;
  				break;
  			}
  		}
  		wm += 2;			
  	}
  	if(x>118){x=0;y++;}
  	LCD_Set_Pos(x , y); 
  	if(adder != 1)// 显示汉字					
  	{
  		LCD_Set_Pos(x , y);
  		for(wm = 0;wm < 14;wm++)               
  		{
  			LCD_WrDat(F14x16[adder]);	
  			adder += 1;
  		}      
  		LCD_Set_Pos(x,y + 1); 
  		for(wm = 0;wm < 14;wm++)          
  		{
  			LCD_WrDat(F14x16[adder]);
  			adder += 1;
  		}   		
  	}
  	else			  //显示空白字符			
  	{
  		ii += 1;
      LCD_Set_Pos(x,y);
  		for(wm = 0;wm < 16;wm++)
  		{
  				LCD_WrDat(0);
  		}
  		LCD_Set_Pos(x,y + 1);
  		for(wm = 0;wm < 16;wm++)
  		{   		
  				LCD_WrDat(0);	
  		}
  	}
  	x += 14;
  	ii += 2;
	}
}
//输出汉字和字符混合字符串
void LCD_Print(byte x, byte y, byte ch[])//y:0~6
{
	byte ch2[3];
	byte ii=0;        
	while(ch[ii] != '\0')
	{
		if(ch[ii] > 127)
		{
			ch2[0] = ch[ii];
	 		ch2[1] = ch[ii + 1];
			ch2[2] = '\0';			//汉字为两个字节
			LCD_P14x16Str(x , y, ch2);	//显示汉字
			x += 14;
			ii += 2;
		}
		else
		{
			ch2[0] = ch[ii];	
			ch2[1] = '\0';			//字母占一个字节
			LCD_P8x16Str(x , y , ch2);	//显示字母
			x += 8;
			ii+= 1;
		}
	}
} 

//==============================================================
//函数名： void Draw_BMP(byte x,byte y)
//功能描述：显示BMP图片128×64
//参数：起始点坐标(x,y),x的范围0～127，y为页的范围0～7
//返回：无
//==============================================================
void Draw_BMP(byte x0,byte y0,byte x1,byte y1,byte bmp[])
{ 	
  word ii=0;
  byte x,y;
  
  if(y1%8==0) y=y1/8;      
  else y=y1/8+1;
	for(y=y0;y<=y1;y++)
	{
		LCD_Set_Pos(x0,y);				
    for(x=x0;x<x1;x++)
	    {      
	    	LCD_WrDat(bmp[ii++]);	    	
	    }
	}
}



void Dis_SNum(byte x, byte y, uint16 num,byte N)
{
 byte j=0;
  byte n[6]={0};
  x=x*8;
  n[0]=(num/10000)%10; 
  n[1]=(num/1000)%10;
  n[2]=(num/100)%10;
  n[3]=(num/10)%10;
  n[4]=num%10;
 // n[6]='\0';
  for(j=0;j<5;j++) n[j]=n[j]+16+32;
  LCD_P6x8Str(x,y,&n[5-N]);//从ACSII码表中读取字节，然后写入液晶


}

void Dis_Num(byte x, byte y, uint16 num,byte N) //y:1~6;
{
  //byte line;
  byte j=0;
  byte n[6]={0};
  x=x*8;
  n[0]=(num/10000)%10; 
  n[1]=(num/1000)%10;
  n[2]=(num/100)%10;
  n[3]=(num/10)%10;
  n[4]=num%10;
 // n[6]='\0';
  for(j=0;j<5;j++) n[j]=n[j]+16+32;
  LCD_P8x16Str(x,y,&n[5-N]);//从ACSII码表中读取字节，然后写入液晶
}

void Dis_Float(byte X,byte Y,double real,byte N) 
{
   byte   i_Count=1;
   byte   n[12]={0};
   long   j=1;  
   uint16   real_int=0;
   double decimal=0;
   uint16   real_decimal=0;
   X=X*8;
   real_int=(int)real;
   //Dis_Num(2,0,real_int,5);
   decimal=real-real_int;
   real_decimal=(uint16)(decimal*1e4);
   //Dis_Num(2,6,real_decimal,4);
   while(real_int/10/j!=0)
   {
      j=j*10;i_Count++;  
   } 
   n[0]=(real_int/10000)%10; 
   n[1]=(real_int/1000)%10;
   n[2]=(real_int/100)%10;
   n[3]=(real_int/10)%10;
   n[4]=(real_int/1)%10; 
   n[5]='.';
   n[6]=(real_decimal/1000)%10;
   n[7]=(real_decimal/100)%10;
   n[8]=(real_decimal/10)%10;
   n[9]=real_decimal%10;
   n[6+N]='\0'; 
   for(j=0;j<10;j++) n[j]=n[j]+16+32;
   n[5]='.';
   n[6+N]='\0';   
   LCD_P8x16Str(X,Y,&n[5-i_Count]); 
}

void Dis_Float2(byte X,byte Y,double real,byte N1,byte N2) 
{
   byte   i_Count=1;
   byte   n[12]={0};
   long   j=1;  
   uint8   real_int=0;
   double decimal=0;
   uint8   real_decimal=0;
   X=X*8;
   real_int=(int)real;
   //Dis_Num(2,0,real_int,5);
   decimal=real-real_int;
   real_decimal=(uint8)(decimal*1e4);
   //Dis_Num(2,6,real_decimal,4);
   while(real_int/10/j!=0)
   {
      j=j*10;i_Count++;  
   } 
   n[0]=(real_int/10000)%10; 
   n[1]=(real_int/1000)%10;
   n[2]=(real_int/100)%10;
   n[3]=(real_int/10)%10;
   n[4]=(real_int/1)%10; 
   n[5]='.';
   n[6]=(real_decimal/1000)%10;
   n[7]=(real_decimal/100)%10;
   n[8]=(real_decimal/10)%10;
   n[9]=real_decimal%10;
   n[6+N2]='\0'; 
   for(j=0;j<10;j++) n[j]=n[j]+16+32;
   n[5]='.';
   n[6+N2]='\0';   
   LCD_P8x16Str(X,Y,&n[5-N1]); 
}


/*************************************************************************
*                           蓝宙电子工作室
*
*  函数名称：OledPrint
*  功能说明：液晶屏显示程序
*  参数说明：ADdataCount  每行的采样点数 ；
*            LineCount 一场采样行数 ；
*            PredatorFAV  二值化阈值
*            dataAD       原始数据
*  函数返回：无
*  修改时间：2015-6-8
*  备    注：OLED设置显示为16行，128点，当采用点大于128时，进行居中显示，小于
*            128从左到右显示。当显示行小于16行时，从上到下滚蛋显示，当显示行大于
*            16行时，进行间隔显示
*************************************************************************/
//补充

void OledPrint(uint16_t ADdataCount,uint16_t LineCount,uint16_t PredatorFAV, uint8 *dataAD )
{
  uint16_t PCount ,OLECount ;
  uint16_t temp0 ,temp1,temp2,temp3,temp4,temp5 ;
  uint8_t plineCount ;
  static uint8 poled[2100] ;
  uint8 *oleddata ; 
  //oleddata = &dataAD [(DATALINE - LineCount)*ADdataCount] ;
  temp1 = 0 ;
  temp0 = 0 ;
  if(LineCount >= 16) 
  { PCount  = LineCount/16 ;
    temp1 = 1 ;
  }
  if( ADdataCount> 128 ) temp0 = (ADdataCount - 128)>>1 ;
  temp5 = 0;
  if(temp1){
    for(temp3 = 0 ; temp3 < 16;temp3++){
      temp1 = temp3*PCount*ADdataCount + temp0 +128;
      for(temp4= temp0 ;temp4 < (temp0+128) ;temp4 ++){
        poled[temp5++] = oleddata[temp1 -temp4];
      }
    }
  }
  else{
    OLECount  = 0  ;
    temp5 = LineCount *128 ;
    for(temp3 = 0; temp3 < (16- LineCount) ;temp3 ++){
      for(temp4= 0 ;temp4 < (128) ;temp4 ++){
       poled[OLECount] = poled[temp5+OLECount] ;
       OLECount++ ;
      }}
    temp1 = 0 ;
    for(; temp3 < (16) ;temp3 ++){   
      temp5 = temp1*ADdataCount + temp0 + 128;
      temp1++ ;
      for(temp4= 0 ;temp4 < (128) ;temp4 ++){
        poled[OLECount] = dataAD[temp5-temp4] ;
        OLECount ++ ;
      }}
  } 
  temp0 = 0; 
  temp3 = 0 ;
   LCD_Fill(0x00);//黑屏 
   LCD_DLY_ms(1);
  for(plineCount = 0 ;plineCount < 8;plineCount ++)
  {
    PCount = 0;
    LCD_Set_Pos(PCount,7-plineCount); 
    temp0 = temp3 ;
    temp3 = 128+temp0;
    for(;PCount<128 ;PCount++)
    {
        temp2 = 0;
        if(poled[temp0 ++ ]<PredatorFAV)
        {
          temp2 |= 0x0c;
        }
        if(poled[temp3 ++ ]<PredatorFAV)
        {
          temp2 |= 0xc0;
        }
          LCD_WrDat(temp2);
    }    
  }
}


/*****************************************************************************
 函 数 名  : LED_PrintImage
 功能描述  : 将图像显示出来
 输入参数  : UCHAR8 *pucTable     二维图像数组的地址
             USHORT16 usRowNum    二维图像的行数1~64
             USHORT16 usColumnNum 二维图像的列数1~128
 输出参数  : none
 返 回 值  : none
*****************************************************************************/
void LED_PrintImage(uint16 usColumnNum,uint16 usRowNum,uint8 *pucTable)
{
    uint8 ucData;
    uint16 i,j,k,m,n;
    uint16 usRowTmp;
    m = usRowNum >> 3;   //计算图片行数以8位为一组完整的组数
    n = usRowNum % 8;    //计算分完组后剩下的行数    
    for(i = 0; i < m; i++) //完整组行扫描
    {
        LCD_Set_Pos(0,(uint8)i);
        usRowTmp = i << 3;    //计算当前所在行的下标                  
        for(j = 0; j < usColumnNum; j++) //列扫描        
        {
            ucData = 0;
            for(k = 0; k < 8; k++) //在i组中对这8行扫描
            {
                ucData = ucData >> 1;
                if((pucTable + (usRowTmp + k) * usColumnNum)[j] == 1)
                {
                    ucData = ucData | 0x80;
                }
                
            }
            LCD_WrDat(ucData);
        }
    }    
    LCD_Set_Pos(0,(uint8)i); //设置剩下的行显示的起始坐标
    usRowTmp = i << 3;       //计算当前所在行的下标                  
    for(j = 0; j < usColumnNum; j++) //列扫描        
    {
        ucData = 0;
        for(k = 0; k < n; k++) //对剩下的行扫描
        {
            ucData = ucData >> 1;
            if((pucTable + (usRowTmp + k) * usColumnNum)[j] == 1)
            {
                ucData = ucData | 0x80;
            }            
        }
        ucData = ucData >> (8 - n);
        LCD_WrDat(ucData);
    }
    return;
}

void OLED_IMAGE(uint8 (*tempimg)[80],uint8 *Certre_Line)
{
  uint8 i,j,x;
  LCD_P6x8Str(0,0,"C_L");
  Dis_SNum(37,0,*Certre_Line,3);
    for(i=1; i<=6; i++)//7次循环完成56*80的图像区
        {
          LCD_Set_Pos(0,i);
            for(j=0; j<80; j++)//一次循环完成一个8*60的图像去
            {
                 x = tempimg[i*8][j]
                    +tempimg[i*8+1][j]*2
                        +tempimg[i*8+2][j]*4
                            +tempimg[i*8+3][j]*8
                                +tempimg[i*8+4][j]*16
                                    +tempimg[i*8+5][j]*32
                                        +tempimg[i*8+6][j]*64
                                            +tempimg[i*8+7][j]*128;//将竖着的8个像素合并成一个字节
                           LCD_WrDat(x);
            }         
        }
        
        //上面的一段程序完成了56行像素的显示，同理，下面显示剩下4行
        LCD_Set_Pos(0,7);
        for(j=0; j<80; j++)
        {
             x = tempimg[56][j]
                +tempimg[57][j]*2
                    +tempimg[58][j]*4
                        +tempimg[59][j]*8;
            LCD_WrDat(x);
        }
    
}
void LCD_ClrDot(unsigned char x)  //线性CCD使用
{
  LCD_Set_Pos(x,0);
	LCD_WrCmd((unsigned char)(0xb0+0));
	LCD_WrCmd((unsigned char)(((x&0xf0)>>4)|0x10));
	LCD_WrCmd((unsigned char)((x&0x0f)|0x00));
	LCD_WrDat(0x00);
        
  LCD_Set_Pos(x,1);
	LCD_WrCmd((unsigned char)(0xb0+1));
	LCD_WrCmd((unsigned char)(((x&0xf0)>>4)|0x10));
	LCD_WrCmd((unsigned char)((x&0x0f)|0x00));
	LCD_WrDat(0x00);
        
  LCD_Set_Pos(x,2);
	LCD_WrCmd((unsigned char)(0xb0+2));
	LCD_WrCmd((unsigned char)(((x&0xf0)>>4)|0x10));
	LCD_WrCmd((unsigned char)((x&0x0f)|0x00));
	LCD_WrDat(0x00);
        
  LCD_Set_Pos(x,3);
	LCD_WrCmd((unsigned char)(0xb0+3));
	LCD_WrCmd((unsigned char)(((x&0xf0)>>4)|0x10));
	LCD_WrCmd((unsigned char)((x&0x0f)|0x00));
	LCD_WrDat(0x00);
        
        LCD_Set_Pos(x,4);
	LCD_WrCmd((unsigned char)(0xb0+4));
	LCD_WrCmd((unsigned char)(((x&0xf0)>>4)|0x10));
	LCD_WrCmd((unsigned char)((x&0x0f)|0x00));
	LCD_WrDat(0x00);
        
        LCD_Set_Pos(x,5);
	LCD_WrCmd((unsigned char)(0xb0+5));
	LCD_WrCmd((unsigned char)(((x&0xf0)>>4)|0x10));
	LCD_WrCmd((unsigned char)((x&0x0f)|0x00));
	LCD_WrDat(0x00);
        
	LCD_Set_Pos(x,6);
	LCD_WrCmd((unsigned char)(0xb0+6));
	LCD_WrCmd((unsigned char)(((x&0xf0)>>4)|0x10));
	LCD_WrCmd((unsigned char)((x&0x0f)|0x00));
	LCD_WrDat(0x00);
	
	LCD_Set_Pos(x,7);
	LCD_WrCmd((unsigned char)(0xb0+7));
	LCD_WrCmd((unsigned char)(((x&0xf0)>>4)|0x10));
	LCD_WrCmd((unsigned char)((x&0x0f)|0x00));
	LCD_WrDat(0x00);
} 

//打印ccd图像
void CCD_IMG(uint8 *Pst,uint8 *Thread)
{
  uint8 tdat,i;
//  uint8 j;
//  LCD_P6x8Str(0,0,"Thread");
//  Dis_SNum(40,0,*Thread,3);
//  j = (*Thread > 55)? *Thread:55; 
//        j = (j - 55)/3;
//        if(j > 63) j = 63;
 
  LCD_Fill(0x00);
  for (i = 16;i<112;i++)
  {
      tdat = (Pst[i] > 55)? Pst[i]:55;           
      tdat = (tdat - 55)/3;
      if(tdat==0) tdat = 5;
      if(tdat > 60) tdat = 60;
//          LCD_ClrDot(i);
      LCD_PutPixel(i ,60-tdat);  //包含有OLED的代码因此要CCD.h要在LQ12864.h之后
//      LCD_PutPixel(i ,63-j); 
     
  }
      
}

//
//void Display_CCD(uint8 * Pst,uint8 *threshold,int *center_line)//显示CCD波形    传递的是128bit的CCD原始数据
//{
//        uint8 tdat;
//        uint8 i;
//        uint8 j;
////        uint8 k;
//        //k = *center_line;
//        //阈值
//        j = (*threshold > 55)? *threshold:55; 
//        j = (j - 55)/3;
//        if(j > 63) j = 63;
//        //波形
//        for(i=PIX_START;i<PIX_END;i++)
//  	{
//          tdat = (Pst[i] > 55)? Pst[i]:55;           
//          tdat = (tdat - 55)/3;
//          if(tdat > 63) tdat = 63;
////          LCD_ClrDot(i);
//          LCD_PutPixel(i ,63-tdat);  //包含有OLED的代码因此要CCD.h要在LQ12864.h之后
//          LCD_PutPixel(i ,63-j); 
//        } 
//        for(i=0;i<8;i++)
//        {
//          LCD_WrCmd(0xb0+i);
//          LCD_WrCmd(((*center_line&0xf0)>>4)|0x10);
//          LCD_WrCmd((*center_line&0x0f)|0x00);
//          LCD_WrDat(0xff);
//        }
//        
//}


void OLED_IMAGE_OV7725(uint8 (*data)[80],int16 *Certre_Line)
{
  uint8 i,j,x;
  LCD_P6x8Str(0,0,"C_L");
  Dis_SNum(37,0,*Certre_Line,3);
   
    for(i=1; i<=6; i++)//7次循环完成56*80的图像区
        {
          LCD_Set_Pos(0,i);
            for(j=0; j<80; j++)//一次循环完成一个8*60的图像去
            {
                 x = data[i*8][j]
                    +data[i*8+1][j]*2
                        +data[i*8+2][j]*4
                            +data[i*8+3][j]*8
                                +data[i*8+4][j]*16
                                    +data[i*8+5][j]*32
                                        +data[i*8+6][j]*64
                                            +data[i*8+7][j]*128;//将竖着的8个像素合并成一个字节
                           LCD_WrDat(x);
            }         
        }
        
        //上面的一段程序完成了56行像素的显示，同理，下面显示剩下4行
        LCD_Set_Pos(0,7);
        for(j=0; j<80; j++)
        {
             x = data[56][j]
                +data[57][j]*2
                    +data[58][j]*4
                        +data[59][j]*8;
            LCD_WrDat(x);
        }
        
        
        
    
}




void MY_OLED_IMAGE(uint8 (*data)[160])
{
  uint8 i,j,x;
     for(i=1; i<=6; i++)//7次循环完成56*80的图像区
        {
          LCD_Set_Pos(0,i);
            for(j=0; j<80; j++)//一次循环完成一个8*60的图像去
            {
                 x = (data[i*8][j*2]+data[i*8][j*2+1])/2
                     +(data[i*8+1][j*2]+data[i*8+1][j*2+1])
                        +(data[i*8+2][j*2]+data[i*8+2][j*2+1])*2
                            +(data[i*8+3][j*2]+data[i*8+3][j*2+1])*4
                                +(data[i*8+4][j*2]+data[i*8+4][j*2+1])*8
                                    +(data[i*8+5][j*2]+data[i*8+5][j*2+1])*16
                                        +(data[i*8+6][j*2]+data[i*8+6][j*2+1])*32
                                            +(data[i*8+7][j*2]+data[i*8+7][j*2+1])*64;//将竖着的8个像素合并成一个字节
                           LCD_WrDat(x);
            }         
        }
        
        //上面的一段程序完成了56行像素的显示，同理，下面显示剩下4行
        LCD_Set_Pos(0,7);
        for(j=0; j<80; j++)
        {
             x = (data[56][j*2]+data[56][j*2+1])/2
                +(data[57][j*2]+data[57][j*2+1])
                    +(data[58][j*2]+data[58][j*2+1])*2
                        +(data[59][j*2]+data[59][j*2+1])*4;
            LCD_WrDat(x);
        }
        
        
        
    
}